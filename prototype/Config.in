## prototype/package/fanboy/Config.in
```kconfig
config BR2_PACKAGE_FANBOY
  bool "FANBOY"
  depends on BR2_PACKAGE_HOST_GO_ARCH_SUPPORTS
  depends on BR2_PACKAGE_HOST_GO_CGO_LINKING_SUPPORTS
  depends on BR2_TOOLCHAIN_HAS_THREADS
  help
    Installs the Fanboy application into the rootfs
```
